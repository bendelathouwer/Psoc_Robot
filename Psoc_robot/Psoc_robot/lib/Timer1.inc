;;*****************************************************************************
;;*****************************************************************************
;;  FILENAME: Timer1.inc
;;   Version: 2.6, Updated on 2015/3/4 at 22:27:47
;;  Generated by PSoC Designer 5.4.3191
;;
;;  DESCRIPTION: Assembler declarations for the Timer16 user module interface
;;-----------------------------------------------------------------------------
;;  Copyright (c) Cypress Semiconductor 2015. All Rights Reserved.
;;*****************************************************************************
;;*****************************************************************************

include "m8c.inc"


;--------------------------------------------------
; Constants for Timer1 API's.
;--------------------------------------------------

Timer1_CONTROL_REG_START_BIT:              equ 0x01    ; Control register start bit
Timer1_INT_REG:                            equ 0x0e1
Timer1_INT_MASK:                           equ 0x02


;--------------------------------------------------
; Constants for Timer1 user defined values
;--------------------------------------------------

Timer1_PERIOD:                             equ 0xffff
Timer1_COMPARE_VALUE:                      equ 0x0


;--------------------------------------------------
; Register Address Constants for Timer1
;--------------------------------------------------

Timer1_COUNTER_LSB_REG:                equ 0x20   ; DR0 Counter register
Timer1_COUNTER_MSB_REG:                equ 0x24
Timer1_PERIOD_LSB_REG:                 equ 0x21   ; DR1 Period register
Timer1_PERIOD_MSB_REG:                 equ 0x25
Timer1_COMPARE_LSB_REG:                equ 0x22   ; DR2 CompareValue register
Timer1_COMPARE_MSB_REG:                equ 0x26
Timer1_CONTROL_LSB_REG:                equ 0x23   ; Control register
Timer1_CONTROL_MSB_REG:                equ 0x27
Timer1_FUNC_LSB_REG:                   equ 0x20   ; Function register
Timer1_FUNC_MSB_REG:                   equ 0x24
Timer1_INPUT_LSB_REG:                  equ 0x21   ; Input register
Timer1_INPUT_MSB_REG:                  equ 0x25
Timer1_OUTPUT_LSB_REG:                 equ 0x22   ; Output register
Timer1_OUTPUT_MSB_REG:                 equ 0x26


;--------------------------------------------------
; Timer1 Macro 'Functions'
;--------------------------------------------------

   macro Timer1_Start_M
   or    reg[Timer1_CONTROL_LSB_REG],  Timer1_CONTROL_REG_START_BIT
   endm

   macro Timer1_Stop_M
   and   reg[Timer1_CONTROL_LSB_REG], ~Timer1_CONTROL_REG_START_BIT
   endm

   macro Timer1_EnableInt_M
   M8C_EnableIntMask Timer1_INT_REG, Timer1_INT_MASK
   endm

   macro Timer1_DisableInt_M
   M8C_DisableIntMask Timer1_INT_REG, Timer1_INT_MASK
   endm


; end of file Timer1.inc
