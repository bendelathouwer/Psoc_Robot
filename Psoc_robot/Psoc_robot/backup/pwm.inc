;;*****************************************************************************
;;*****************************************************************************
;;  FILENAME: PWM.inc
;;   Version: 2.5, Updated on 2015/3/4 at 22:26:51
;;  Generated by PSoC Designer 5.4.3191
;;
;;  DESCRIPTION: Assembler declarations for the PWM16 user module interface
;;-----------------------------------------------------------------------------
;;  Copyright (c) Cypress Semiconductor 2015. All Rights Reserved.
;;*****************************************************************************
;;*****************************************************************************

include "m8c.inc"


;--------------------------------------------------
; Constants for PWM API's.
;--------------------------------------------------

PWM_CONTROL_REG_START_BIT:                 equ 0x01    ; Control register start bit
PWM_INT_REG:                               equ 0x0df
PWM_INT_MASK:                              equ 0x02


;--------------------------------------------------
; Constants for PWM user defined values
;--------------------------------------------------

PWM_PERIOD:                                equ 0x3e8
PWM_PULSE_WIDTH:                           equ 0x1388


;--------------------------------------------------
; Register Address Constants for PWM
;--------------------------------------------------

PWM_COUNTER_LSB_REG:                   equ 0x40   ; DR0 Count register
PWM_COUNTER_MSB_REG:                   equ 0x44
PWM_PERIOD_LSB_REG:                    equ 0x41   ; DR1 Period register
PWM_PERIOD_MSB_REG:                    equ 0x45
PWM_COMPARE_LSB_REG:                   equ 0x42   ; DR2 Compare register
PWM_COMPARE_MSB_REG:                   equ 0x46
PWM_CONTROL_LSB_REG:                   equ 0x43   ; Control register
PWM_CONTROL_MSB_REG:                   equ 0x47
PWM_FUNC_LSB_REG:                      equ 0x40   ; Function register
PWM_FUNC_MSB_REG:                      equ 0x44
PWM_INPUT_LSB_REG:                     equ 0x41   ; Input register
PWM_INPUT_MSB_REG:                     equ 0x45
PWM_OUTPUT_LSB_REG:                    equ 0x42   ; Output register
PWM_OUTPUT_MSB_REG:                    equ 0x46


;--------------------------------------------------
; PWM Macro 'Functions'
;--------------------------------------------------

   macro PWM_Start_M
   or    reg[PWM_CONTROL_LSB_REG],  PWM_CONTROL_REG_START_BIT
   endm

   macro PWM_Stop_M
   and   reg[PWM_CONTROL_LSB_REG], ~PWM_CONTROL_REG_START_BIT
   endm

   macro PWM_EnableInt_M
   M8C_EnableIntMask PWM_INT_REG, PWM_INT_MASK
   endm

   macro PWM_DisableInt_M
   M8C_DisableIntMask PWM_INT_REG, PWM_INT_MASK
   endm


; end of file PWM.inc

