;;*****************************************************************************
;;*****************************************************************************
;;  FILENAME: PWM1.inc
;;   Version: 2.5, Updated on 2015/3/4 at 22:26:51
;;  Generated by PSoC Designer 5.4.3191
;;
;;  DESCRIPTION: Assembler declarations for the PWM16 user module interface
;;-----------------------------------------------------------------------------
;;  Copyright (c) Cypress Semiconductor 2015. All Rights Reserved.
;;*****************************************************************************
;;*****************************************************************************

include "m8c.inc"


;--------------------------------------------------
; Constants for PWM1 API's.
;--------------------------------------------------

PWM1_CONTROL_REG_START_BIT:                equ 0x01    ; Control register start bit
PWM1_INT_REG:                              equ 0x0df
PWM1_INT_MASK:                             equ 0x02


;--------------------------------------------------
; Constants for PWM1 user defined values
;--------------------------------------------------

PWM1_PERIOD:                               equ 0x3e8
PWM1_PULSE_WIDTH:                          equ 0x1388


;--------------------------------------------------
; Register Address Constants for PWM1
;--------------------------------------------------

PWM1_COUNTER_LSB_REG:                  equ 0x40   ; DR0 Count register
PWM1_COUNTER_MSB_REG:                  equ 0x44
PWM1_PERIOD_LSB_REG:                   equ 0x41   ; DR1 Period register
PWM1_PERIOD_MSB_REG:                   equ 0x45
PWM1_COMPARE_LSB_REG:                  equ 0x42   ; DR2 Compare register
PWM1_COMPARE_MSB_REG:                  equ 0x46
PWM1_CONTROL_LSB_REG:                  equ 0x43   ; Control register
PWM1_CONTROL_MSB_REG:                  equ 0x47
PWM1_FUNC_LSB_REG:                     equ 0x40   ; Function register
PWM1_FUNC_MSB_REG:                     equ 0x44
PWM1_INPUT_LSB_REG:                    equ 0x41   ; Input register
PWM1_INPUT_MSB_REG:                    equ 0x45
PWM1_OUTPUT_LSB_REG:                   equ 0x42   ; Output register
PWM1_OUTPUT_MSB_REG:                   equ 0x46


;--------------------------------------------------
; PWM1 Macro 'Functions'
;--------------------------------------------------

   macro PWM1_Start_M
   or    reg[PWM1_CONTROL_LSB_REG],  PWM1_CONTROL_REG_START_BIT
   endm

   macro PWM1_Stop_M
   and   reg[PWM1_CONTROL_LSB_REG], ~PWM1_CONTROL_REG_START_BIT
   endm

   macro PWM1_EnableInt_M
   M8C_EnableIntMask PWM1_INT_REG, PWM1_INT_MASK
   endm

   macro PWM1_DisableInt_M
   M8C_DisableIntMask PWM1_INT_REG, PWM1_INT_MASK
   endm


; end of file PWM1.inc

