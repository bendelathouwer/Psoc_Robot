;;*****************************************************************************
;;*****************************************************************************
;;  FILENAME: PWM.inc
;;   Version: 2.5, Updated on 2015/3/4 at 22:26:51
;;  Generated by PSoC Designer 5.4.3191
;;
;;  DESCRIPTION: Assembler declarations for the PWM16 user module interface
;;-----------------------------------------------------------------------------
;;  Copyright (c) Cypress Semiconductor 2015. All Rights Reserved.
;;*****************************************************************************
;;*****************************************************************************

include "m8c.inc"


;--------------------------------------------------
; Constants for PWM API's.
;--------------------------------------------------

PWM_CONTROL_REG_START_BIT:                 equ 0x01    ; Control register start bit
PWM_INT_REG:                               equ 0x0e1
PWM_INT_MASK:                              equ 0x02


;--------------------------------------------------
; Constants for PWM user defined values
;--------------------------------------------------

PWM_PERIOD:                                equ 0x0
PWM_PULSE_WIDTH:                           equ 0x0


;--------------------------------------------------
; Register Address Constants for PWM
;--------------------------------------------------

PWM_COUNTER_LSB_REG:                   equ 0x20   ; DR0 Count register
PWM_COUNTER_MSB_REG:                   equ 0x24
PWM_PERIOD_LSB_REG:                    equ 0x21   ; DR1 Period register
PWM_PERIOD_MSB_REG:                    equ 0x25
PWM_COMPARE_LSB_REG:                   equ 0x22   ; DR2 Compare register
PWM_COMPARE_MSB_REG:                   equ 0x26
PWM_CONTROL_LSB_REG:                   equ 0x23   ; Control register
PWM_CONTROL_MSB_REG:                   equ 0x27
PWM_FUNC_LSB_REG:                      equ 0x20   ; Function register
PWM_FUNC_MSB_REG:                      equ 0x24
PWM_INPUT_LSB_REG:                     equ 0x21   ; Input register
PWM_INPUT_MSB_REG:                     equ 0x25
PWM_OUTPUT_LSB_REG:                    equ 0x22   ; Output register
PWM_OUTPUT_MSB_REG:                    equ 0x26


;--------------------------------------------------
; PWM Macro 'Functions'
;--------------------------------------------------

   macro PWM_Start_M
   or    reg[PWM_CONTROL_LSB_REG],  PWM_CONTROL_REG_START_BIT
   endm

   macro PWM_Stop_M
   and   reg[PWM_CONTROL_LSB_REG], ~PWM_CONTROL_REG_START_BIT
   endm

   macro PWM_EnableInt_M
   M8C_EnableIntMask PWM_INT_REG, PWM_INT_MASK
   endm

   macro PWM_DisableInt_M
   M8C_DisableIntMask PWM_INT_REG, PWM_INT_MASK
   endm


; end of file PWM.inc

