;  Generated by PSoC Designer 5.4.3191
;
; LCDD4 address and mask equates
LCDD4_Data_ADDR:	equ	0h
LCDD4_DriveMode_0_ADDR:	equ	100h
LCDD4_DriveMode_1_ADDR:	equ	101h
LCDD4_DriveMode_2_ADDR:	equ	3h
LCDD4_GlobalSelect_ADDR:	equ	2h
LCDD4_IntCtrl_0_ADDR:	equ	102h
LCDD4_IntCtrl_1_ADDR:	equ	103h
LCDD4_IntEn_ADDR:	equ	1h
LCDD4_MASK:	equ	1h
; LCDD5 address and mask equates
LCDD5_Data_ADDR:	equ	0h
LCDD5_DriveMode_0_ADDR:	equ	100h
LCDD5_DriveMode_1_ADDR:	equ	101h
LCDD5_DriveMode_2_ADDR:	equ	3h
LCDD5_GlobalSelect_ADDR:	equ	2h
LCDD5_IntCtrl_0_ADDR:	equ	102h
LCDD5_IntCtrl_1_ADDR:	equ	103h
LCDD5_IntEn_ADDR:	equ	1h
LCDD5_MASK:	equ	2h
; P_0_2 address and mask equates
P_0_2_Data_ADDR:	equ	0h
P_0_2_DriveMode_0_ADDR:	equ	100h
P_0_2_DriveMode_1_ADDR:	equ	101h
P_0_2_DriveMode_2_ADDR:	equ	3h
P_0_2_GlobalSelect_ADDR:	equ	2h
P_0_2_IntCtrl_0_ADDR:	equ	102h
P_0_2_IntCtrl_1_ADDR:	equ	103h
P_0_2_IntEn_ADDR:	equ	1h
P_0_2_MASK:	equ	4h
; LCDE address and mask equates
LCDE_Data_ADDR:	equ	0h
LCDE_DriveMode_0_ADDR:	equ	100h
LCDE_DriveMode_1_ADDR:	equ	101h
LCDE_DriveMode_2_ADDR:	equ	3h
LCDE_GlobalSelect_ADDR:	equ	2h
LCDE_IntCtrl_0_ADDR:	equ	102h
LCDE_IntCtrl_1_ADDR:	equ	103h
LCDE_IntEn_ADDR:	equ	1h
LCDE_MASK:	equ	10h
; LCDRS address and mask equates
LCDRS_Data_ADDR:	equ	0h
LCDRS_DriveMode_0_ADDR:	equ	100h
LCDRS_DriveMode_1_ADDR:	equ	101h
LCDRS_DriveMode_2_ADDR:	equ	3h
LCDRS_GlobalSelect_ADDR:	equ	2h
LCDRS_IntCtrl_0_ADDR:	equ	102h
LCDRS_IntCtrl_1_ADDR:	equ	103h
LCDRS_IntEn_ADDR:	equ	1h
LCDRS_MASK:	equ	20h
