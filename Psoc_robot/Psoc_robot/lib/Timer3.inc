;;*****************************************************************************
;;*****************************************************************************
;;  FILENAME: Timer3.inc
;;   Version: 2.6, Updated on 2015/3/4 at 22:27:47
;;  Generated by PSoC Designer 5.4.3191
;;
;;  DESCRIPTION: Assembler declarations for the Timer16 user module interface
;;-----------------------------------------------------------------------------
;;  Copyright (c) Cypress Semiconductor 2015. All Rights Reserved.
;;*****************************************************************************
;;*****************************************************************************

include "m8c.inc"


;--------------------------------------------------
; Constants for Timer3 API's.
;--------------------------------------------------

Timer3_CONTROL_REG_START_BIT:              equ 0x01    ; Control register start bit
Timer3_INT_REG:                            equ 0x0e1
Timer3_INT_MASK:                           equ 0x20


;--------------------------------------------------
; Constants for Timer3 user defined values
;--------------------------------------------------

Timer3_PERIOD:                             equ 0xffff
Timer3_COMPARE_VALUE:                      equ 0x0


;--------------------------------------------------
; Register Address Constants for Timer3
;--------------------------------------------------

Timer3_COUNTER_LSB_REG:                equ 0x30   ; DR0 Counter register
Timer3_COUNTER_MSB_REG:                equ 0x34
Timer3_PERIOD_LSB_REG:                 equ 0x31   ; DR1 Period register
Timer3_PERIOD_MSB_REG:                 equ 0x35
Timer3_COMPARE_LSB_REG:                equ 0x32   ; DR2 CompareValue register
Timer3_COMPARE_MSB_REG:                equ 0x36
Timer3_CONTROL_LSB_REG:                equ 0x33   ; Control register
Timer3_CONTROL_MSB_REG:                equ 0x37
Timer3_FUNC_LSB_REG:                   equ 0x30   ; Function register
Timer3_FUNC_MSB_REG:                   equ 0x34
Timer3_INPUT_LSB_REG:                  equ 0x31   ; Input register
Timer3_INPUT_MSB_REG:                  equ 0x35
Timer3_OUTPUT_LSB_REG:                 equ 0x32   ; Output register
Timer3_OUTPUT_MSB_REG:                 equ 0x36


;--------------------------------------------------
; Timer3 Macro 'Functions'
;--------------------------------------------------

   macro Timer3_Start_M
   or    reg[Timer3_CONTROL_LSB_REG],  Timer3_CONTROL_REG_START_BIT
   endm

   macro Timer3_Stop_M
   and   reg[Timer3_CONTROL_LSB_REG], ~Timer3_CONTROL_REG_START_BIT
   endm

   macro Timer3_EnableInt_M
   M8C_EnableIntMask Timer3_INT_REG, Timer3_INT_MASK
   endm

   macro Timer3_DisableInt_M
   M8C_DisableIntMask Timer3_INT_REG, Timer3_INT_MASK
   endm


; end of file Timer3.inc
